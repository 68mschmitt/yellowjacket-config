/* SPDX-License-Identifier: MIT */
/ {
    split_inputs {
        #address-cells = <1>;
        #size-cells = <0>;

        power_left: power_left@1 {
            compatible = "zmk,input-split";
            reg = <1>;
            status = "disabled";
        };
    };
};

/* SPDX-License-Identifier: MIT */
/ {
    split_inputs {
        #address-cells = <1>;
        #size-cells = <0>;

        /* Keep the right half's original single channel and GATT layout.
         * Motion, DPI and power telemetry share it using distinct event codes. */
        mouse_split: mouse_split@0 {
            compatible = "zmk,input-split";
            reg = <0>;
        };
    };
};

## boards/shields/yellowjacket/Kconfig.defconfig
```kconfig
# Copyright (c) 2020 The ZMK Contributors
# SPDX-License-Identifier: MIT

if SHIELD_YELLOJACKET_LEFT

config ZMK_KEYBOARD_NAME
    default "Yellow Jacket"

config ZMK_SPLIT_ROLE_CENTRAL
    default y

endif

if SHIELD_YELLOJACKET_LEFT || SHIELD_YELLOJACKET_RIGHT
config ZMK_SPLIT
    default y

endif
```

## boards/shields/yellowjacket/Kconfig.shield
```kconfig
# Copyright (c) 2020 The ZMK Contributors
# SPDX-License-Identifier: MIT

config SHIELD_YELLOJACKET_LEFT
    def_bool $(shields_list_contains,yellowjacket_left)

config SHIELD_YELLOJACKET_RIGHT
    def_bool $(shields_list_contains,yellowjacket_right)
```

## boards/shields/yellowjacket_yj1/Kconfig.defconfig
```kconfig
# Copyright (c) 2020 The ZMK Contributors
# SPDX-License-Identifier: MIT

if SHIELD_YELLOWJACKET_YJ1_LEFT

config ZMK_KEYBOARD_NAME
	default "YJ1"

config ZMK_SPLIT_ROLE_CENTRAL
	default y

endif

if SHIELD_YELLOWJACKET_YJ1_RIGHT

config ZMK_KEYBOARD_NAME
	default "YJ1_R"

endif

if SHIELD_YELLOWJACKET_YJ1_RIGHT || SHIELD_YELLOWJACKET_YJ1_LEFT

config ZMK_SPLIT
	default y

endif
```

## boards/shields/yellowjacket_yj1/Kconfig.shield
```kconfig
# Copyright (c) 2020 The ZMK Contributors
# SPDX-License-Identifier: MIT

config SHIELD_YELLOWJACKET_YJ1_LEFT
	def_bool $(shields_list_contains,yellowjacket_yj1_left)

config SHIELD_YELLOWJACKET_YJ1_RIGHT
	def_bool $(shields_list_contains,yellowjacket_yj1_right)
```

## boards/shields/yellowjacket_yj2/Kconfig.defconfig
```kconfig
# Copyright (c) 2020 The ZMK Contributors
# SPDX-License-Identifier: MIT

if SHIELD_YELLOWJACKET_YJ2_LEFT

config ZMK_KEYBOARD_NAME
	default "YJ2"

config ZMK_SPLIT_ROLE_CENTRAL
	default y

endif

if SHIELD_YELLOWJACKET_YJ2_RIGHT

config ZMK_KEYBOARD_NAME
	default "YJ2_R"

config SSD1306_REVERSE_MODE
	default y

endif

if SHIELD_YELLOWJACKET_YJ2_RIGHT || SHIELD_YELLOWJACKET_YJ2_LEFT

config ZMK_SPLIT
	default y


if ZMK_DISPLAY

config ZMK_DISPLAY
    select LV_USE_CONT
    select LV_FONT_MONTSERRAT_26
    select LV_FONT_MONTSERRAT_16
    select LV_USE_LABEL
    select LV_USE_IMG

config I2C
	default y

config SSD1306
	default y

endif # ZMK_DISPLAY


if LVGL

config LV_Z_VDB_SIZE
    default 64

config LV_Z_MEM_POOL_SIZE
    default 5120
config LV_DPI_DEF
    int
    default 148

config LV_Z_BITS_PER_PIXEL
    default 1

choice LV_COLOR_DEPTH
    default LV_COLOR_DEPTH_1
endchoice

endif # LVGL

endif
```

## boards/shields/yellowjacket_yj2/Kconfig.shield
```kconfig
# Copyright (c) 2020 The ZMK Contributors
# SPDX-License-Identifier: MIT

config SHIELD_YELLOWJACKET_YJ2_LEFT
	def_bool $(shields_list_contains,yellowjacket_yj2_left)

config SHIELD_YELLOWJACKET_YJ2_RIGHT
	def_bool $(shields_list_contains,yellowjacket_yj2_right)
```

## config/boards/shields/Kconfig.defconfig
```kconfig
if SHEILD_YELLOWJACKET_LEFT

config ZMK_KEYBOARD_NAME
    default "Yellow Jacket"

config ZMK_SPLIT_ROLE_CENTRAL
    default y

endif

if SHEILD_YELLOWJACKET_LEFT || SHEILD_YELLOWJACKET_RIGHT

config ZMK_SPLIT
    default y

config BT_CTLR
    default BT

if USB

config USB_NRFX
    default y

config USB_DEVICE_STACK
    default y

endif

endif
```

## config/boards/shields/Kconfig.shield
```kconfig
config SHEILD_YELLOWJACKET_LEFT
    def_bool $(shields_list_contains, yellowjacket_left)

config SHEILD_YELLOWJACKET_RIGHT
    def_bool $(shields_list_contains, yellowjacket_right)
```

## config/boards/shields/bolbol/Kconfig.shield
```kconfig
# Copyright (c) 2022 The ZMK Contributors
# SPDX-License-Identifier: MIT

config SHIELD_BOLBOL
	def_bool $(shields_list_contains,bolbol)
```

## config/boards/shields/gnat/Kconfig.defconfig
```kconfig
# Copyright (c) 2020 The ZMK Contributors
# SPDX-License-Identifier: MIT

if SHIELD_GNAT_LEFT

config ZMK_KEYBOARD_NAME
	default "gnat_L"

config ZMK_SPLIT_BLE_ROLE_CENTRAL
	default y

endif

if SHIELD_GNAT_RIGHT

config ZMK_KEYBOARD_NAME
	default "gnat_R"

endif

if SHIELD_GNAT_RIGHT || SHIELD_GNAT_LEFT

config ZMK_SPLIT
	default y

endif


if ZMK_DISPLAY

config ZMK_DISPLAY
    select LV_USE_CONT
    select LV_FONT_MONTSERRAT_26
    select LV_FONT_MONTSERRAT_16
    select LV_USE_LABEL
    select LV_USE_IMG

config I2C
	default y

config SSD1306
	default y

config SSD1306_REVERSE_MODE
    bool
	default n

endif # ZMK_DISPLAY
```

## config/boards/shields/gnat/Kconfig.shield
```kconfig
# Copyright (c) 2020 The ZMK Contributors
# SPDX-License-Identifier: MIT

config SHIELD_GNAT_LEFT
	def_bool $(shields_list_contains,gnat_left)

config SHIELD_GNAT_RIGHT
	def_bool $(shields_list_contains,gnat_right)
```

## config/boards/shields/tern/Kconfig.defconfig
```kconfig
# Copyright (c) 2022 The ZMK Contributors
# SPDX-License-Identifier: MIT

if SHIELD_tern

config ZMK_KEYBOARD_NAME
    default "tern"

endif
```

## config/modules/yellowjacket/boards/shields/yellowjacket_left/Kconfig.shield
```kconfig
config SHIELD_YELLOWJACKET_LEFT
    def_bool $(shields_list_contains,yellowjacket_left)
```

## config/modules/yellowjacket/boards/shields/yellowjacket_right/Kconfig.shield
```kconfig
config SHIELD_YELLOWJACKET_RIGHT
    def_bool $(shields_list_contains,yellowjacket_right)
```

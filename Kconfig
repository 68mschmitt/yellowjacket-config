## Kconfig
```kconfig
# Copyright (c) 2024 The ZMK Contributors
# SPDX-License-Identifier: MIT

config PINCHWING_DISPLAY_DIAGNOSTICS
    bool "Log Pinchwing display startup and delay it for USB log capture"
    depends on SHIELD_PINCHWING_ROUND && ZMK_USB_LOGGING
    default n
    help
      Wait ten seconds on the display queue before constructing the screen,
      then log startup stages and completed display frames over USB.

config ZMK_BEHAVIOR_DYNAMIC_MACRO
    bool
    default y
    depends on DT_HAS_ZMK_BEHAVIOR_DYNAMIC_MACRO_ENABLED

if ZMK_BEHAVIOR_DYNAMIC_MACRO

config ZMK_BEHAVIOR_DYNAMIC_MACRO_MAX_SLOTS
    int "Dynamic macro slots (registers)"
    default 25
    range 1 32
    help
      Number of independent dynamic macro registers. Each slot costs
      MAX_EVENTS * 12 bytes of RAM plus a small fixed overhead, allocated
      statically whether or not the slot is ever used.

config ZMK_BEHAVIOR_DYNAMIC_MACRO_MAX_EVENTS
    int "Dynamic macro events per slot"
    default 64
    range 8 1024
    help
      Maximum recorded key events per slot. One ordinary key tap is two events
      (press and release), so 128 events is roughly 64 keystrokes. A few events
      of headroom are reserved so that stopping a recording can always append
      releases for keys that are still held.

config ZMK_BEHAVIOR_DYNAMIC_MACRO_MAX_HELD
    int "Dynamic macro maximum simultaneously held keys"
    default 10
    range 2 32
    help
      How many keys may be held down at once while recording. Recording
      auto-stops if this is exceeded, so that playback stays balanced.

config ZMK_BEHAVIOR_DYNAMIC_MACRO_TAP_DELAY
    int "Dynamic macro playback delay (ms)"
    default 20
    range 1 1000
    help
      Delay in milliseconds between events during playback. Original recording
      timing is not retained. Values below ~10ms may overrun slow hosts.

endif # ZMK_BEHAVIOR_DYNAMIC_MACRO
```

## boards/shields/pinchwing_dongle/Kconfig.defconfig
```kconfig
# SPDX-License-Identifier: MIT

if SHIELD_PINCHWING_DONGLE_LEFT || SHIELD_PINCHWING_DONGLE_RIGHT || SHIELD_PINCHWING_DONGLE_RECEIVER

config ZMK_SPLIT
	default y

config ZMK_KEYBOARD_NAME
	default "Pinchwing USB"

endif

if SHIELD_PINCHWING_DONGLE_RECEIVER

config ZMK_SPLIT_ROLE_CENTRAL
	default y

config ZMK_SPLIT_BLE_CENTRAL_PERIPHERALS
	default 2

config BT_MAX_CONN
	default 7

config BT_MAX_PAIRED
	default 7

endif
```

## boards/shields/pinchwing_dongle/Kconfig.shield
```kconfig
# SPDX-License-Identifier: MIT

config SHIELD_PINCHWING_DONGLE_LEFT
	def_bool $(shields_list_contains,pinchwing_dongle_left)

config SHIELD_PINCHWING_DONGLE_RIGHT
	def_bool $(shields_list_contains,pinchwing_dongle_right)

config SHIELD_PINCHWING_DONGLE_RECEIVER
	def_bool $(shields_list_contains,pinchwing_dongle_receiver)
```

## boards/shields/pinchwing_round/Kconfig.shield
```kconfig
# SPDX-License-Identifier: MIT
config SHIELD_PINCHWING_ROUND
	def_bool $(shields_list_contains,pinchwing_round)
```

## boards/shields/pinchwing_sharp/Kconfig.shield
```kconfig
# SPDX-License-Identifier: MIT
config SHIELD_PINCHWING_SHARP
	def_bool $(shields_list_contains,pinchwing_sharp)
```

## boards/shields/yellowjacket_mouse/Kconfig.defconfig
```kconfig
# SPDX-License-Identifier: MIT

if SHIELD_YELLOWJACKET_MOUSE_LEFT

config ZMK_KEYBOARD_NAME
	default "Pinchwing V0 L"

endif

if SHIELD_YELLOWJACKET_MOUSE_RIGHT

config ZMK_KEYBOARD_NAME
	default "Pinchwing V0"

config ZMK_SPLIT_ROLE_CENTRAL
	default y

endif

if SHIELD_YELLOWJACKET_MOUSE_LEFT || SHIELD_YELLOWJACKET_MOUSE_RIGHT

config ZMK_SPLIT
	default y

endif
```

## boards/shields/yellowjacket_mouse/Kconfig.shield
```kconfig
# SPDX-License-Identifier: MIT

config SHIELD_YELLOWJACKET_MOUSE_LEFT
	def_bool $(shields_list_contains,yellowjacket_mouse_left)

config SHIELD_YELLOWJACKET_MOUSE_RIGHT
	def_bool $(shields_list_contains,yellowjacket_mouse_right)
```

## dts/bindings/behaviors/zmk,behavior-dynamic-macro.yaml
```yaml
# Copyright (c) 2024 The ZMK Contributors
# SPDX-License-Identifier: MIT

description: Dynamic (runtime recordable) macro behavior

compatible: "zmk,behavior-dynamic-macro"

include: two_param.yaml
```

## dts/bindings/behaviors/zmk,behavior-pmw3610-dpi.yaml
```yaml
description: Adjust PMW3610 CPI by 200, bounded to the sensor range
compatible: "zmk,behavior-pmw3610-dpi"
include: one_param.yaml
properties:
  "#binding-cells":
    const: 1
```
